
#include "CH374HFM.H"

#define	CH374_SPI_SCS	GPIOB->BRR		/* 假定CH374的SCS引脚 */
#define	SPI_IF_TRANS	0x80	/* SPI字节传输完成标志,在SPSR的位7 */




/*******************************************************************************
* 函数名称  : Spi374Start
* 函数功能  : 370芯片可以通过spi通讯
* 入口参数  : 数据存放的地址 addr，需要写入的命令cmd
* 返回参数  : 无
* 函数说明  : 
* 修改日志  ：刘晓琳 于2013年03月11日修改
*******************************************************************************/
static	void	Spi374Start( unsigned char addr, unsigned char cmd )  	/* SPI开始 */
{
 																	/* SPI片选有效 拉低*/
	GPIOA->BRR=0x800;
	Spi374OutByte( addr ); //通过spi发送操作的地址
	Spi374OutByte( cmd );  //通过spi发送命令字
}
#define	Spi374Stop( )	{ GPIOA->BSRR =0x800; }  						/* SPI结束 拉高*/

 
/*******************************************************************************
* 函数名称  : CH374_READ_REGISTER
* 函数功能  : 从370芯片的某个地址读出一个字节的数据
* 入口参数  : 读出数据的地址mAddr
* 返回参数  : 读出的数据d
* 函数说明  : 
* 修改日志  ：刘晓琳 于2013年03月11日修改
*******************************************************************************/
UINT8	CH374_READ_REGISTER( UINT8 mAddr )  /* 外部定义的被CH374程序库调用的子程序,从指定寄存器读取数据 */
{
	UINT8	d;
	Spi374Start( mAddr, CMD_SPI_374READ );
	d = Spi374InByte( );
	Spi374Stop( );
	return( d );
}

/*******************************************************************************
* 函数名称  : CH374_WRITE_REGISTER
* 函数功能  : 向370芯片的某个地址写入一个字节的数据
* 入口参数  : 数据存放的地址mAddr，需要写入的数据mData
* 返回参数  : 无
* 函数说明  : 
* 修改日志  ：刘晓琳 于2013年03月11日修改
*******************************************************************************/
void	CH374_WRITE_REGISTER( UINT8 mAddr, UINT8 mData )  /* 外部定义的被CH374程序库调用的子程序,向指定寄存器写入数据 */
{
	Spi374Start( mAddr, CMD_SPI_374WRITE );
	Spi374OutByte( mData );
	Spi374Stop( );
}

/*******************************************************************************
* 函数名称  : CH374_READ_BLOCK
* 函数功能  : 从370芯片的某个地址读出mLen个字节的数据，存放在mBuf中
* 入口参数  : 读出数据的首地址Waddr，读数据的字节数mLen，存放的缓存的首地址mBuf
* 返回参数  : 无
* 函数说明  : 
* 修改日志  ：刘晓琳 于2013年03月11日修改
*******************************************************************************/
void	CH374_READ_BLOCK( UINT8 mAddr, UINT8 mLen, PUINT8 mBuf )  /* 外部定义的被CH374程序库调用的子程序,从指定起始地址读出数据块 */
{
	Spi374Start( mAddr, CMD_SPI_374READ );
	while ( mLen -- ) *mBuf++ = Spi374InByte( );
	Spi374Stop( );
}

/*******************************************************************************
* 函数名称  : CH374_WRITE_BLOCK
* 函数功能  : 将缓存mBuf中的前mLen个字节的数据写入370芯片
* 入口参数  : 数据存放的首地址Waddr，需要写入的数据的长度mLen，需要写入的数据所存放的缓存mBuf
* 返回参数  : 无
* 函数说明  : 
* 修改日志  ：刘晓琳 于2013年03月11日修改
*******************************************************************************/
void	CH374_WRITE_BLOCK( UINT8 mAddr, UINT8 mLen, PUINT8 mBuf )  /* 外部定义的被CH374程序库调用的子程序,向指定起始地址写入数据块 */
{
	Spi374Start( mAddr, CMD_SPI_374WRITE );
	while ( mLen -- ) Spi374OutByte( *mBuf++ );
	Spi374Stop( );

}

/*******************************************************************************
* 函数名称  : CH374_READ_BLOCK64
* 函数功能  : 从370芯片的某个地址读64个字节的数据，存放在mBuf中
* 入口参数  : 读出数据的首地址Waddr，存放的缓存的首地址mBuf
* 返回参数  : 写入数据后的缓存的地址
* 函数说明  : 
* 修改日志  ：刘晓琳 于2013年03月11日修改
*******************************************************************************/
PUINT8	CH374_READ_BLOCK64( UINT8 mAddr, PUINT8 mBuf )  /* 外部定义的被CH374程序库调用的子程序,从双缓冲区读出64字节的数据块,返回当前地址 */
{
	UINT8	i;
	Spi374Start( mAddr, CMD_SPI_374READ );
	for ( i = CH374_BLOCK_SIZE; i != 0; i -- ) *mBuf++ = Spi374InByte( );
	Spi374Stop( );
	return( mBuf );
}

/*******************************************************************************
* 函数名称  : CH374_WRITE_BLOCK64
* 函数功能  : 将缓存mBuf中的前64个字节的数据写入370芯片
* 入口参数  : 数据存放的首地址Waddr，需要写入的数据所存放的缓存mBuf
* 返回参数  : 写入数据后的缓存的地址
* 函数说明  : 
* 修改日志  ：刘晓琳 于2013年03月11日修改
*******************************************************************************/
PUINT8	CH374_WRITE_BLOCK64( UINT8 mAddr, PUINT8 mBuf )  /* 外部定义的被CH374程序库调用的子程序,向双缓冲区写入64字节的数据块,返回当前地址 */
{
	UINT8	i;
	Spi374Start( mAddr, CMD_SPI_374WRITE );
	for ( i = CH374_BLOCK_SIZE; i != 0; i -- ) Spi374OutByte( *mBuf++ );
	Spi374Stop( );
	return( mBuf );
}

/*******************************************************************************
* 函数名称  : CH374_WRITE_BLOCK_C
* 函数功能  : 将缓存mBuf中的前mLen个字节的数据写入370芯片的ram中
* 入口参数  : 需要写入的数据的长度mLen，需要写入的数据所存放的缓存mBuf
* 返回参数  : 无
* 函数说明  : 
* 修改日志  ：刘晓琳 于2013年03月11日修改
*******************************************************************************/
void	CH374_WRITE_BLOCK_C( UINT8 mLen, PUINT8C mBuf )  /* 外部定义的被CH374程序库调用的子程序,向RAM_HOST_TRAN写入常量型数据块 */
{
	Spi374Start( RAM_HOST_TRAN, CMD_SPI_374WRITE );
	do {
		Spi374OutByte( *mBuf );
		mBuf ++;
	} while ( -- mLen );
	Spi374Stop( );
}
